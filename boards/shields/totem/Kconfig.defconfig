## boards/shields/totem/Kconfig.defconfig
```kconfig
# SPDX-License-Identifier: MIT

config ZMK_SPLIT
    default y
    depends on SHIELD_TOTEM_LEFT || SHIELD_TOTEM_RIGHT

if SHIELD_TOTEM_LEFT
    config ZMK_KEYBOARD_NAME
        default "TOTEM_L"
endif

if SHIELD_TOTEM_RIGHT
    config ZMK_KEYBOARD_NAME
        default "TOTEM_R"
endif
```

## boards/shields/totem/Kconfig.shield
```kconfig
# No whitespace after the comma or in your part name!
config SHIELD_TOTEM_LEFT
    def_bool $(shields_list_contains,totem_left)

# No whitespace after the comma or in your part name!
config SHIELD_TOTEM_RIGHT
    def_bool $(shields_list_contains,totem_right)
```
